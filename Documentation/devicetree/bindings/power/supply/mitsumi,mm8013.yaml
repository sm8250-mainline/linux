## Documentation/devicetree/bindings/power/supply/mitsumi,mm8013.yaml
```yaml
# SPDX-License-Identifier: GPL-2.0
%YAML 1.2
---
$id: http://devicetree.org/schemas/power/supply/mitsumi,mm8013.yaml#
$schema: http://devicetree.org/meta-schemas/core.yaml#

title: Mitsumi MM8013 fuel gauge

maintainers:
  - Konrad Dybcio <konradybcio@kernel.org>

properties:
  compatible:
    const: mitsumi,mm8013

  reg:
    maxItems: 1

required:
  - compatible
  - reg

additionalProperties: false

examples:
  - |
    i2c {
      #address-cells = <1>;
      #size-cells = <0>;

      fuel-gauge@55 {
        compatible = "mitsumi,mm8013";
        reg = <0x55>;
      };
    };
```
